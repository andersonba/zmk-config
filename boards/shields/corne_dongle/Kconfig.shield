## boards/shields/crosses/Kconfig.shield
```kconfig
config SHIELD_CROSSES_LEFT
    def_bool $(shields_list_contains,crosses_left)

config SHIELD_CROSSES_RIGHT
    def_bool $(shields_list_contains,crosses_right)
```

## config/boards/shields/crosses/Kconfig.defconfig
```kconfig
if SHIELD_CROSSES_RIGHT

config ZMK_KEYBOARD_NAME
	default "Crosses"

config ZMK_SPLIT_BLE_ROLE_CENTRAL
	default y

endif

if SHIELD_CROSSES_LEFT || SHIELD_CROSSES_RIGHT

config ZMK_SPLIT
	default y

endif
```
