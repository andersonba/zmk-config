## boards/shields/crosses/Kconfig.defconfig
```kconfig
if SHIELD_CROSSES_DONGLE

config ZMK_KEYBOARD_NAME
	default "Crosses"

config ZMK_SPLIT_ROLE_CENTRAL
	default y

config ZMK_SPLIT
	default y

config ZMK_SPLIT_BLE_CENTRAL_PERIPHERALS
	default 2

config BT_MAX_CONN
	default 7

config BT_MAX_PAIRED
	default 7

endif

if SHIELD_CROSSES_RIGHT

config ZMK_KEYBOARD_NAME
	default "Crosses"

config ZMK_SPLIT_BLE_ROLE_CENTRAL
	default y

endif

if SHIELD_CROSSES_LEFT || SHIELD_CROSSES_RIGHT || SHIELD_CROSSES_DONGLE

config ZMK_SPLIT
	default y

endif
```

## boards/shields/viginti/Kconfig.defconfig
```kconfig
if SHIELD_VIGINTI_DONGLE

config ZMK_KEYBOARD_NAME
	default "Viginti"

config ZMK_SPLIT_ROLE_CENTRAL
	default y

config ZMK_SPLIT
	default y

config ZMK_SPLIT_BLE_CENTRAL_PERIPHERALS
	default 2

config BT_MAX_CONN
	default 7

config BT_MAX_PAIRED
	default 7

endif

if SHIELD_VIGINTI_LEFT

config ZMK_KEYBOARD_NAME
	default "Viginti"

endif

if SHIELD_VIGINTI_LEFT || SHIELD_VIGINTI_RIGHT || SHIELD_VIGINTI_DONGLE

config ZMK_SPLIT
	default y

endif
```

## boards/shields/viginti/Kconfig.shield
```kconfig
config SHIELD_VIGINTI_LEFT
    def_bool $(shields_list_contains,viginti_left)

config SHIELD_VIGINTI_RIGHT
    def_bool $(shields_list_contains,viginti_right)

config SHIELD_VIGINTI_DONGLE
    def_bool $(shields_list_contains,viginti_dongle)
```

## config/west.yml
```yaml
manifest:
  remotes:
    - name: zmkfirmware
      url-base: https://github.com/zmkfirmware
    - name: duckyb
      url-base: https://github.com/duckyb
    - name: urob
      url-base: https://github.com/urob
    - name: m165437
      url-base: https://github.com/M165437

    - name: efogdev
      url-base: https://github.com/efogdev
    - name: kot149
      url-base: https://github.com/kot149
    - name: badjeff
      url-base: https://github.com/badjeff

  # Revisions pinned to the tested checkouts of 2026-10-29; bump deliberately.
  projects:
    - name: zmk
      remote: zmkfirmware
      revision: 4dd95d7840eb3d5a3f59bb29fbf1ab054715ef85 # main @ 2026-10-09
      import: app/west.yml
    - name: zmk-helpers
      remote: urob
      revision: 7bcba18fc8df27303eb92a435d33ea870cc51f98 # main @ 2026-09-10

    # Shields
    - name: urchin-zmk-module
      remote: duckyb
      revision: a3ab64fa7779f82675695f3d7d17f705f840da25 # main @ 2024-11-14
    - name: zmk-pmw3610-driver
      remote: efogdev
      revision: 38105b4f09d6d5b94ef5a3073428719e3c356af1 # zephyr-4.1 @ 2026-04-17

    # ZMK modules
    - name: zmk-adaptive-key
      remote: urob
      revision: e987227d625e8863343baf16bd11ff90310482a5 # main @ 2026-09-09
    - name: zmk-auto-layer
      remote: urob
      revision: b50d514219c5ad61198f9a8be137c59d0674b11c # main @ 2026-09-09
    - name: zmk-tri-state
      remote: urob
      revision: c08969627245adeddbcdb6dfc1a4c167c04160e2 # main @ 2026-09-10
    - name: zmk-scroll-snap
      remote: kot149
      revision: 2feeb988f5b5a3c2b5e09ba6472e86e6902463a2 # v1 @ 2026-10-19
    - name: zmk-behavior-battery-percentage-printer
      remote: badjeff
      revision: e111cbc6ac66caaa157daeb58eda3c8e2b43153a # main @ 2025-11-17

    # Custom Nice!View
    - name: nice-view-gem
      remote: m165437
      revision: 0a50fe209d929c916c5664c6affd0f4977c6b012 # main @ 2026-02-27

  self:
    path: config
```
