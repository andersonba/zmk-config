// Viginti — 20-key split (2x4+2 per side).
//
// Too small for the shared 34-key logic in base.dtsi, so this board keeps its
// own layers: each alpha layout is split across a home layer and a shift layer
// (momentary, on the left inner thumb). QWERTY is the default and Gallium is
// toggled on from Sys, same as the other boards.

#include <behaviors.dtsi>
#include <dt-bindings/zmk/keys.h>
#include <dt-bindings/zmk/bt.h>
#include <dt-bindings/zmk/outputs.h>
#include <zmk-helpers/helper.h>

// Layers
#define BASE1 0   // QWERTY
#define BASE2 1   // QWERTY, top row + inner column
#define ALPHA1 2  // Gallium v1
#define ALPHA2 3  // Gallium v1, top row + inner column
#define NUM 4
#define SYM 5
#define FN 6
#define SYS 7

#define LAYOUTS BASE1 BASE2 ALPHA1 ALPHA2
#define LAYOUT_HOMES BASE1 ALPHA1

// Timings
#define QUICK_TAP_MS 150
#define STICKY_RELEASE_MS 900
#define TAPPING_TERM_MS 230
#define HRM_TAPPING_TERM 230
#define HRM_PRIOR_IDLE 150
#define PAIR_TAPPING_TERM 150
#define COMBO_TERM_FAST 35
#define COMBO_IDLE_FAST 100

// After the timings — behaviors.dtsi and macros.dtsi read them.
#include "./behaviors.dtsi"
#include "./macros.dtsi"

/*                KEY POSITIONS
 * ╭─────────────────╮ ╭─────────────────╮
 * │ LM3 LM2 LM1 LM0 │ │ RM0 RM1 RM2 RM3 │  <- home row
 * │ LB3 LB2 LB1 LB0 │ │ RB0 RB1 RB2 RB3 │
 * ╰───────╮ LH1 LH0 │ │ RH0 RH1 ╭───────╯
 *         ╰─────────╯ ╰─────────╯
 */
#define LM3  0
#define LM2  1
#define LM1  2
#define LM0  3
#define RM0  4
#define RM1  5
#define RM2  6
#define RM3  7
#define LB3  8
#define LB2  9
#define LB1 10
#define LB0 11
#define RB0 12
#define RB1 13
#define RB2 14
#define RB3 15
#define LH1 16
#define LH0 17
#define RH0 18
#define RH1 19

#define KEYS_L LM3 LM2 LM1 LM0 LB3 LB2 LB1 LB0
#define KEYS_R RM0 RM1 RM2 RM3 RB0 RB1 RB2 RB3
#define THUMBS LH1 LH0 RH0 RH1

#define XXX &none
#define ___ &trans

#define ZMK_VIGINTI_LAYER(name, LM, RM, LB, RB, LH, RH) \
ZMK_LAYER(name, \
  LM RM \
  LB RB \
  LH RH \
)

#define SMART_SPACE &spc_morph

// HRMs — timeless recipe from behaviors.dtsi, positions of this board
MAKE_HRM(hml, &kp, &kp, KEYS_R THUMBS, HRM_TAPPING_TERM, HRM_PRIOR_IDLE) // Left-hand HRMs.
MAKE_HRM(hmr, &kp, &kp, KEYS_L THUMBS, HRM_TAPPING_TERM, HRM_PRIOR_IDLE) // Right-hand HRMs.

// Tap/hold char pairs (F-keys, brackets) — resolve by timeout only
ZMK_HOLD_TAP(ht_pair,
  bindings = <&kp>, <&kp>;
  flavor = "tap-preferred";
  tapping-term-ms = <PAIR_TAPPING_TERM>;
  quick-tap-ms = <QUICK_TAP_MS>;
)

// Caps: tap = caps-word | double-tap = caps lock (no magic_shift thumb here)
ZMK_TAP_DANCE(td_caps,
  tapping-term-ms = <TAPPING_TERM_MS>;
  bindings = <&caps_word>, <&kp CAPS>;
)

// CMD+Tab swapper on Fn. The Fn combo is a cross-hand thumb chord, so
// releasing either thumb interrupts the tri-state and closes the switcher.
ZMK_TRI_STATE(swapper,
  bindings = <&kt LGUI>, <&kp TAB>, <&kt LGUI>;
  timeout-ms = <1500>;
)

// Combos (same finger pairs and layer reach as combos.dtsi on the 34-key boards)
ZMK_COMBO(l_esc,      &kp ESC,        LM1 LM2, LAYOUTS SYM,     COMBO_TERM_FAST, COMBO_IDLE_FAST)
ZMK_COMBO(l_tab,      &kp TAB,        LM0 LM1, LAYOUTS SYM,     COMBO_TERM_FAST, COMBO_IDLE_FAST)
/* right hand: backspace on the home pair (the viginti HRMs have no row above,
 * so deletion lives strongest under the fingers). No delete-word combo: hold
 * the left HRM alt (or cmd) with the same pair — S+JK = ⌥⌫, A+JK = ⌘⌫.
 * Esc keeps the home K+L; enter takes the bottom. */
ZMK_COMBO(r_enter,    &kp ENTER,      RB0 RB1, LAYOUTS NUM,     COMBO_TERM_FAST, COMBO_IDLE_FAST)
ZMK_COMBO(r_esc,      &kp ESC,        RM1 RM2, LAYOUTS NUM,     COMBO_TERM_FAST, COMBO_IDLE_FAST)
ZMK_COMBO(r_bkp,      &kp BACKSPACE,  RM0 RM1, LAYOUTS NUM,     COMBO_TERM_FAST, COMBO_IDLE_FAST)
ZMK_COMBO(caps,       &td_caps,       LM1 RM1, LAYOUT_HOMES,    COMBO_TERM_FAST, COMBO_IDLE_FAST)
ZMK_COMBO(fn,         &mo FN,         LH1 RH1, LAYOUT_HOMES,    COMBO_TERM_FAST, COMBO_IDLE_FAST)
ZMK_COMBO(sys,        &mo SYS,        LH0 RH0, LAYOUT_HOMES,    COMBO_TERM_FAST, COMBO_IDLE_FAST)

/* symbols: both chars + cursor inside (vertical combos, right hand)
 * — the 34-key boards use the inner columns for these; here the free
 *   vertical pairs (home+bottom, same finger) take that role */
ZMK_COMBO(both_par, &both_par, RM0 RB0, LAYOUTS, COMBO_TERM_FAST, COMBO_IDLE_FAST)
ZMK_COMBO(both_brk, &both_brk, RM1 RB1, LAYOUTS, COMBO_TERM_FAST, COMBO_IDLE_FAST)
ZMK_COMBO(both_brc, &both_brc, RM2 RB2, LAYOUTS, COMBO_TERM_FAST, COMBO_IDLE_FAST)

/* system (dongle triggers on Sys layer) */
ZMK_COMBO(boot_dongle,  &bootloader,    LB3 RB3, SYS,     COMBO_TERM_FAST, COMBO_IDLE_FAST)
ZMK_COMBO(reset_dongle, &sys_reset,     LB2 RB2, SYS,     COMBO_TERM_FAST, COMBO_IDLE_FAST)

// LAYERS {{{
#define QMARK_EXCL &qmark_excl
#define DOT_COLON &dot_colon
#define COMMA_SEMI &comma_semicolon

ZMK_VIGINTI_LAYER(Base1, // QWERTY (home + bottom rows)
//╭──────────────────┬──────────────────┬──────────────────┬──────────────────╮ ╭──────────────────┬──────────────────┬──────────────────┬──────────────────╮
    &hml LGUI A        &hml LALT S        &hml LSHFT D       &hml LCTRL F     ,   &hmr RCTRL J       &hmr RSHFT K       &hmr RALT L        &hmr RGUI SQT    ,
//├──────────────────┼──────────────────┼──────────────────┼──────────────────┤ ├──────────────────┼──────────────────┼──────────────────┼──────────────────┤
    &kp Z              &kp X              &kp C              &kp V            ,   &kp M              COMMA_SEMI         DOT_COLON          QMARK_EXCL       ,
//╰──────────────────┴──────────────────┼──────────────────┼──────────────────┤ ├──────────────────┼──────────────────┴──────────────────┴──────────────────╯
                                          &smart_num NUM NUM &mo BASE2        ,   SMART_SPACE        &mo SYM
//                                      ╰──────────────────┴──────────────────╯ ╰──────────────────┴──────────────────╯
)

ZMK_VIGINTI_LAYER(Base2, // QWERTY (top row + inner column via layer shift)
//╭──────────────────┬──────────────────┬──────────────────┬──────────────────╮ ╭──────────────────┬──────────────────┬──────────────────┬──────────────────╮
    &hml LGUI Q        &hml LALT W        &hml LSHFT E       &hml LCTRL R     ,   &hmr RCTRL U       &hmr RSHFT I       &hmr RALT O        &hmr RGUI P      ,
//├──────────────────┼──────────────────┼──────────────────┼──────────────────┤ ├──────────────────┼──────────────────┼──────────────────┼──────────────────┤
    &kp T              &kp G              &kp B              &kp LSHFT        ,   &kp RSHFT          &kp N              &kp H              &kp Y            ,
//╰──────────────────┴──────────────────┼──────────────────┼──────────────────┤ ├──────────────────┼──────────────────┴──────────────────┴──────────────────╯
                                          ___                ___              ,   ___                ___
//                                      ╰──────────────────┴──────────────────╯ ╰──────────────────┴──────────────────╯
)

ZMK_VIGINTI_LAYER(Alpha1, // Gallium v1 (home + bottom rows)
//╭──────────────────┬──────────────────┬──────────────────┬──────────────────╮ ╭──────────────────┬──────────────────┬──────────────────┬──────────────────╮
    &hml LGUI N        &hml LALT R        &hml LSHFT T       &hml LCTRL S     ,   &hmr RCTRL H       &hmr RSHFT A       &hmr RALT E        &hmr RGUI I      ,
//├──────────────────┼──────────────────┼──────────────────┼──────────────────┤ ├──────────────────┼──────────────────┼──────────────────┼──────────────────┤
    &kp X              &kp Q              &kp M              &kp W            ,   &kp F              &kp SQT            &kp SEMI           DOT_COLON        ,
//╰──────────────────┴──────────────────┼──────────────────┼──────────────────┤ ├──────────────────┼──────────────────┴──────────────────┴──────────────────╯
                                          &smart_num NUM NUM &mo ALPHA2       ,   SMART_SPACE        &mo SYM
//                                      ╰──────────────────┴──────────────────╯ ╰──────────────────┴──────────────────╯
)

ZMK_VIGINTI_LAYER(Alpha2, // Gallium v1 (top row via layer shift)
//╭──────────────────┬──────────────────┬──────────────────┬──────────────────╮ ╭──────────────────┬──────────────────┬──────────────────┬──────────────────╮
    &hml LGUI B        &hml LALT L        &hml LSHFT D       &hml LCTRL C     ,   &hmr RCTRL Y       &hmr RSHFT O       &hmr RALT U        COMMA_SEMI       ,
//├──────────────────┼──────────────────┼──────────────────┼──────────────────┤ ├──────────────────┼──────────────────┼──────────────────┼──────────────────┤
    &kp V              &kp G              &kp Z              &kp LSHFT        ,   &kp RSHFT          &kp K              &kp P              &kp J            ,
//╰──────────────────┴──────────────────┼──────────────────┼──────────────────┤ ├──────────────────┼──────────────────┴──────────────────┴──────────────────╯
                                          ___                ___              ,   ___                ___
//                                      ╰──────────────────┴──────────────────╯ ╰──────────────────┴──────────────────╯
)

ZMK_VIGINTI_LAYER(Num,
//╭──────────────────┬──────────────────┬──────────────────┬──────────────────╮ ╭──────────────────┬──────────────────┬──────────────────┬──────────────────╮
    &kp PERCENT        &kp N7             &kp N8             &kp N9           ,   &kp N4             &kp N5             &kp N6             &kp SLASH        ,
//├──────────────────┼──────────────────┼──────────────────┼──────────────────┤ ├──────────────────┼──────────────────┼──────────────────┼──────────────────┤
    &kp GRAVE          &kp AT             &kp HASH           &kp DOLLAR       ,   &kp N1             &kp N2             &kp N3             &kp DOT          ,
//╰──────────────────┴──────────────────┼──────────────────┼──────────────────┤ ├──────────────────┼──────────────────┴──────────────────┴──────────────────╯
                                          ___                ___              ,   &kp N0             &kp MINUS
//                                      ╰──────────────────┴──────────────────╯ ╰──────────────────┴──────────────────╯
)

// Mirrors the base.dtsi Sym structure: held mods on the left symbols,
// arrows on the right home row, bracket pairs on the right bottom row.
// @ # $ % ^ do not fit; they live on Num, on the fingers base.dtsi gives them.
ZMK_VIGINTI_LAYER(Sym,
//╭──────────────────┬──────────────────┬──────────────────┬──────────────────╮ ╭──────────────────┬──────────────────┬──────────────────┬──────────────────╮
    &hml LGUI TILDE    &hml LALT BSLH     &hml LSHFT SLASH   &hml LCTRL AMPS  ,   &kp LEFT           &kp DOWN           &kp UP             &kp RIGHT        ,
//├──────────────────┼──────────────────┼──────────────────┼──────────────────┤ ├──────────────────┼──────────────────┼──────────────────┼──────────────────┤
    &kp CARET          &kp LT             &kp GT             &kp EQUAL        ,   &ht_pair LBRC LBKT &kp LPAR           &kp RPAR           &ht_pair RBRC RBKT,
//╰──────────────────┴──────────────────┼──────────────────┼──────────────────┤ ├──────────────────┼──────────────────┴──────────────────┴──────────────────╯
                                          &kp UNDERSCORE     &kp MINUS        ,   &kp ASTRK          ___
//                                      ╰──────────────────┴──────────────────╯ ╰──────────────────┴──────────────────╯
)

// Mirrors base.dtsi: media left, F-keys right climbing bottom to top.
// No third row here, so F7-F9 and F12 ride as the hold of the row above.
ZMK_VIGINTI_LAYER(Fn,
//╭──────────────────┬──────────────────┬──────────────────┬──────────────────╮ ╭──────────────────┬──────────────────┬──────────────────┬──────────────────╮
    &swapper           &kp C_MUTE         &kp C_VOL_UP       &kp C_PP         ,   &ht_pair F7 F4     &ht_pair F8 F5     &ht_pair F9 F6     &ht_pair F12 F11 ,
//├──────────────────┼──────────────────┼──────────────────┼──────────────────┤ ├──────────────────┼──────────────────┼──────────────────┼──────────────────┤
    XXX                &kp C_PREV         &kp C_VOL_DN       &kp C_NEXT       ,   &kp F1             &kp F2             &kp F3             &kp F10          ,
//╰──────────────────┴──────────────────┼──────────────────┼──────────────────┤ ├──────────────────┼──────────────────┴──────────────────┴──────────────────╯
                                          ___                ___              ,   ___                ___
//                                      ╰──────────────────┴──────────────────╯ ╰──────────────────┴──────────────────╯
)

#define BT_CLR_HOLD &bt_clr_hold 0 0
ZMK_VIGINTI_LAYER(Sys,
//╭──────────────────┬──────────────────┬──────────────────┬──────────────────╮ ╭──────────────────┬──────────────────┬──────────────────┬──────────────────╮
    &soft_off          &out OUT_TOG       &bt_prof 4 4       &tog ALPHA1      ,   &bt_prof 0 0       &bt_prof 1 1       &bt_prof 2 2       BT_CLR_HOLD      ,
//├──────────────────┼──────────────────┼──────────────────┼──────────────────┤ ├──────────────────┼──────────────────┼──────────────────┼──────────────────┤
    &bootloader        &sys_reset         XXX                XXX              ,   &lock              &bt_prof 3 3       &sys_reset         &bootloader      ,
//╰──────────────────┴──────────────────┼──────────────────┼──────────────────┤ ├──────────────────┼──────────────────┴──────────────────┴──────────────────╯
                                          ___                ___              ,   ___                ___
//                                      ╰──────────────────┴──────────────────╯ ╰──────────────────┴──────────────────╯
)
// }}}
