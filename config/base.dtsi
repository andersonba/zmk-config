#define HOST_OS 2

#include <behaviors.dtsi>
#include <dt-bindings/zmk/keys.h>
#include <dt-bindings/zmk/bt.h>
#include <dt-bindings/zmk/outputs.h>
#include <zmk-helpers/helper.h>

#include <dt-bindings/zmk/behaviors.h>
#include <behaviors/num_word.dtsi>
#include <behaviors/unicode.dtsi>

// Layers
#define BASE 0
#define NUM 1
#define SYM 2
#define FN 3
#define SYS 4
#define MOUSE 5
#define SCROLL 6

// Mouse layer behavior (tap: toggle | hold: momentary)
#ifdef ENABLE_MOUSE_LAYER
ZMK_HOLD_TAP(mo_tog_mouse,
  bindings = <&mo>, <&tog>;
  flavor = "balanced";
  tapping-term-ms = <230>;
  quick-tap-ms = <150>;
)
#define MO_TOG_MOUSE &mo_tog_mouse MOUSE MOUSE
#endif

// Timings
#define QUICK_TAP_MS 150
#define HRM_TAPPING_TERM 230
#define HRM_PRIOR_IDLE 130
#define TAPPING_TERM_MS 230
#define TAPPING_TERM_MS_TAP 230
#define STICKY_RELEASE_MS 900
#define PASTE_DELAY_MS 300
#define COMBO_TERM_FAST 35
#define COMBO_TERM_SLOW 50
#define COMBO_IDLE_FAST 100
#define COMBO_IDLE_SLOW 50

#define KEYS_L LT0 LT1 LT2 LT3 LT4 LM0 LM1 LM2 LM3 LM4 LB0 LB1 LB2 LB3 LB4
#define KEYS_R RT0 RT1 RT2 RT3 RT4 RM0 RM1 RM2 RM3 RM4 RB0 RB1 RB2 RB3 RB4
#ifndef LH2
  #define THUMBS LH1 LH0 RH0 RH1         // 34 keys
#else
  #define THUMBS LH2 LH1 LH0 RH0 RH1 RH2 // 36+ keys.
#endif

#define XXX &none
#define ___ &trans

&sk { // Sticky Key
  release-after-ms = <STICKY_RELEASE_MS>;
  quick-release;
};

&lt { // Layer Tap
  flavor = "balanced";
  tapping-term-ms = <TAPPING_TERM_MS>;
  quick-tap-ms = <QUICK_TAP_MS>;
};

&caps_word {
  /delete-property/ ignore-modifiers;
};

// Trigger tap-action on all interrupts.
#define MT_CORE \
  flavor = "tap-preferred"; \
  tapping-term-ms = <TAPPING_TERM_MS_TAP>; \
  quick-tap-ms = <TAPPING_TERM_MS_TAP>; \
  hold-trigger-key-positions = <0>;

&mt { 
  MT_CORE
};

#include "./macros.dtsi"
#include "./extra.dtsi"

// HRM {{{
#define MAKE_HRM(NAME, HOLD, TAP, TRIGGER_POS, TAPPING_TERM, PRIOR_IDLE) \
  ZMK_HOLD_TAP(NAME, \
    bindings = <HOLD>, <TAP>; \
    flavor = "balanced"; \
    tapping-term-ms = <TAPPING_TERM>; \
    quick-tap-ms = <QUICK_TAP_MS>; \
    require-prior-idle-ms = <PRIOR_IDLE>; \
    hold-trigger-key-positions = <TRIGGER_POS>; \
    hold-trigger-on-release; \
  )

MAKE_HRM(hml, &kp, &kp, KEYS_R THUMBS, HRM_TAPPING_TERM, HRM_PRIOR_IDLE) // Left-hand HRMs.
MAKE_HRM(hmr, &kp, &kp, KEYS_L THUMBS, HRM_TAPPING_TERM, HRM_PRIOR_IDLE) // Right-hand HRMs.

#define ZMK_COMBO_8(NAME, TAP, POS, LAYERS, COMBO_MS, IDLE_MS, HOLD, SIDE) \
  MAKE_HRM(hm_combo_##NAME, &kp, TAP, SIDE THUMBS, HRM_TAPPING_TERM, HRM_PRIOR_IDLE) \
  ZMK_COMBO_6(NAME, &hm_combo_##NAME HOLD 0, POS, LAYERS, COMBO_MS, IDLE_MS)
// }}}

// HELPERS {{{
#define SIMPLE_MORPH(NAME, MOD, BINDING1, BINDING2)                            \
  ZMK_MOD_MORPH(NAME, mods = <(MOD_L##MOD | MOD_R##MOD)>;                      \
                bindings = <BINDING1>, <BINDING2>;)

#ifndef ZMK_BASE_LAYER
#define ZMK_BASE_LAYER(name, LT, RT, LM, RM, LB, RB, LH, RH) \
ZMK_LAYER(name, \
  LT RT \
  LM RM \
  LB RB \
  LH RH \
)
#endif
/// }}}

// magic shift {{{
ZMK_HOLD_TAP(magic_shift, bindings = <&kp>, <&magic_shift_tap>;
  flavor = "balanced"; tapping-term-ms = <200>;
  quick-tap-ms = <QUICK_TAP_MS>;)
ZMK_MOD_MORPH(magic_shift_tap, bindings = <&shift_repeat>, <&caps_word>;
  mods = <(MOD_LSFT)>;)
ZMK_ADAPTIVE_KEY(shift_repeat, bindings = <&sk LSHFT>;
  repeat {
    trigger-keys = <A B C D E F G H I J K L M N O P Q R S T U V W X Y Z>;
    bindings = <&key_repeat>;
    max-prior-idle-ms = <1200>;
    strict-modifiers;
  };)
// }}}

// Tap: comma | shift + tap: semicolon
SIMPLE_MORPH(comma_semicolon, SFT, &kp COMMA, &kp SEMICOLON)

// Tap: dot | shift + tap: colon
SIMPLE_MORPH(dot_colon, SFT, &kp DOT, &kp COLON)

// Tap: qmark | shift + tap: excl.
SIMPLE_MORPH(qmark_excl, SFT, &kp QMARK, &kp EXCL)

// Tap: space | Shift + tap: dot -> space -> sticky shift.
SIMPLE_MORPH(spc_morph, SFT, &kp SPACE, &dot_spc)
 
// Tap: copy | long-tap: cut (single execution, no repeat).
ZMK_HOLD_TAP(tap_copy_cut, bindings = <&cut>, <&kp>; MT_CORE)

// Paste with initial delay before repeat
ZMK_HOLD_TAP(tap_paste, bindings = <&kp>, <&kp>;
  flavor = "hold-preferred";
  tapping-term-ms = <PASTE_DELAY_MS>;  // delay before repeat starts (ms)
  quick-tap-ms = <0>;
  hold-trigger-key-positions = <0>;
)

// CMD+Tab swapper for macOS (tri-state behavior)
// Allows holding CMD while repeatedly pressing TAB or arrow keys to navigate
ZMK_TRI_STATE(swapper,
  bindings = <&kt LGUI>, <&kp TAB>, <&kt LGUI>;
  ignored-key-positions = <LT2 LM1 LM2 LM3>;  // Allow UP, LEFT, DOWN, RIGHT while swapping
  timeout-ms = <1500>;
)

#include "./combos.dtsi"

// Combos for layers
ZMK_COMBO(fn, &mo FN,
    LH1 RH1, BASE, COMBO_TERM_FAST, COMBO_IDLE_FAST)
ZMK_COMBO(sys, &mo SYS,
    LH0 RH0, BASE, COMBO_TERM_FAST, COMBO_IDLE_FAST)

// LAYERS {{{
#define MAGIC_SHIFT &magic_shift LSHFT 0
#define QMARK_EXCL &qmark_excl
#define DOT_COLON &dot_colon
#define COMMA_SEMI &comma_semicolon
#define SMART_SPACE &spc_morph
ZMK_BASE_LAYER(Base,
//╭─────────────┬─────────────┬─────────────┬─────────────┬─────────────╮ ╭─────────────┬─────────────┬─────────────┬─────────────┬─────────────╮
    &kp Q         &kp W         &kp E         &kp R         &kp T       ,   &kp Y         &kp U         &kp I         &kp O         &kp P       ,
//├─────────────┼─────────────┼─────────────┼─────────────┼─────────────┤ ├─────────────┼─────────────┼─────────────┼─────────────┼─────────────┤
    &hml LGUI A   &hml LALT S   &hml LSHFT D  &hml LCTRL F  &kp G       ,   &kp H         &hmr RCTRL J  &hmr RSHFT K  &hmr RALT L  &hmr RGUI SQT,
//├─────────────┼─────────────┼─────────────┼─────────────┼─────────────┤ ├─────────────┼─────────────┼─────────────┼─────────────┼─────────────┤
    &kp Z         &kp X         &kp C         &kp V         &kp B       ,   &kp N         &kp M         COMMA_SEMI    DOT_COLON     QMARK_EXCL  ,
//╰─────────────┼─────────────┴─────────────┼─────────────┼─────────────┤ ├─────────────┼─────────────┼─────────────┴─────────────┴─────────────╯
                                              &mo NUM       MAGIC_SHIFT ,   SMART_SPACE   &mo SYM      
//                                          ╰─────────────┴─────────────╯ ╰─────────────┴─────────────╯
)

#define WIN_CYCLE &kp LG(GRAVE)
#define ALT_TAB &swapper
#define GO_BACK &kp LG(LBKT)
#define GO_FORWD &kp LG(RBKT)
#define N_UNDO &kp LG(Z)
#define N_CUT &kp LG(X)
#define N_COPY &tap_copy_cut 0 LG(C)
#define N_PASTE &tap_paste LG(V) LG(V)
#define N_REDO &kp LS(LG(Z))
ZMK_BASE_LAYER(Num,
//╭─────────────┬─────────────┬─────────────┬─────────────┬─────────────╮ ╭─────────────┬─────────────┬─────────────┬─────────────┬─────────────╮
    WIN_CYCLE     GO_BACK       &kp UP        GO_FORWD      XXX         ,   &kp PLUS      &kp N7        &kp N8        &kp N9        &kp MINUS   ,
//├─────────────┼─────────────┼─────────────┼─────────────┼─────────────┤ ├─────────────┼─────────────┼─────────────┼─────────────┼─────────────┤
    ALT_TAB       &kp LEFT      &kp DOWN      &kp RIGHT     XXX         ,   &kp ASTERISK  &kp N4        &kp N5        &kp N6        &kp SLASH   ,
//├─────────────┼─────────────┼─────────────┼─────────────┼─────────────┤ ├─────────────┼─────────────┼─────────────┼─────────────┼─────────────┤
    N_UNDO        N_CUT         N_COPY        N_PASTE       N_REDO      ,   &kp COMMA     &kp N1        &kp N2        &kp N3        &kp DOT     ,
//╰─────────────┼─────────────┴─────────────┼─────────────┼─────────────┤ ├─────────────┼─────────────┼─────────────┴─────────────┴─────────────╯
                                              ___           ___         ,   &kp N0        &kp EQUAL
//                                          ╰─────────────┴─────────────╯ ╰─────────────┴─────────────╯
)

#define GO_HOME &kp LG(LBKT)
#define GO_END &kp LG(RBKT)
ZMK_BASE_LAYER(Sym,
//╭─────────────┬─────────────┬─────────────┬─────────────┬─────────────╮ ╭─────────────┬─────────────┬─────────────┬─────────────┬─────────────╮
    &kp GRAVE     &kp AT        &kp HASH      &kp DOLLAR    &kp PERCENT ,   &kp LBKT      &kp LPAR      &kp RPAR      &kp RBKT      &kp PIPE    ,
//├─────────────┼─────────────┼─────────────┼─────────────┼─────────────┤ ├─────────────┼─────────────┼─────────────┼─────────────┼─────────────┤
    &kp TILDE     &kp BSLH      &kp SLASH     &kp AMPS      &kp ASTERISK,   &kp LEFT      &kp DOWN      &kp UP        &kp RIGHT     &kp COLON   ,
//├─────────────┼─────────────┼─────────────┼─────────────┼─────────────┤ ├─────────────┼─────────────┼─────────────┼─────────────┼─────────────┤
    &kp CARET     &kp LT        &kp GT        &kp EQUAL     &kp PLUS    ,   GO_HOME       &kp LBRC      &kp RBRC      GO_END        &kp SEMI    ,
//╰─────────────┼─────────────┴─────────────┼─────────────┼─────────────┤ ├─────────────┼─────────────┼─────────────┴─────────────┴─────────────╯
                                              &kp UNDER     &kp MINUS   ,   ___           ___
//                                          ╰─────────────┴─────────────╯ ╰─────────────┴─────────────╯
)

ZMK_BASE_LAYER(Fn,
//╭─────────────┬─────────────┬─────────────┬─────────────┬─────────────╮ ╭─────────────┬─────────────┬─────────────┬─────────────┬─────────────╮
    XXX           XXX           &kp C_VOL_UP  &kp C_PP      XXX         ,   XXX           &kp F7        &kp F8        &kp F9        &kp F12     ,
//├─────────────┼─────────────┼─────────────┼─────────────┼─────────────┤ ├─────────────┼─────────────┼─────────────┼─────────────┼─────────────┤
    XXX           &kp C_PREV    &kp C_VOL_DN  &kp C_NEXT    XXX         ,   XXX           &kp F4        &kp F5        &kp F6        &kp F11     ,
//├─────────────┼─────────────┼─────────────┼─────────────┼─────────────┤ ├─────────────┼─────────────┼─────────────┼─────────────┼─────────────┤
    XXX           XXX           XXX           XXX           &lock       ,   XXX           &kp F1        &kp F2        &kp F3        &kp F10     ,
//╰─────────────┼─────────────┴─────────────┼─────────────┼─────────────┤ ├─────────────┼─────────────┼─────────────┴─────────────┴─────────────╯
                                              ___           ___         ,   ___           ___
//                                          ╰─────────────┴─────────────╯ ╰─────────────┴─────────────╯
)

ZMK_BASE_LAYER(Sys,
//╭─────────────┬─────────────┬─────────────┬─────────────┬─────────────╮ ╭─────────────┬─────────────┬─────────────┬─────────────┬─────────────╮
    &bt BT_SEL 0  &bt BT_SEL 1  &bt BT_SEL 2  &bt BT_SEL 3  &bt BT_CLR  ,   XXX           XXX           XXX           XXX           XXX         ,
//├─────────────┼─────────────┼─────────────┼─────────────┼─────────────┤ ├─────────────┼─────────────┼─────────────┼─────────────┼─────────────┤
    &bootloader   &studio_unlock XXX          XXX           XXX         ,   XXX           XXX           XXX           &studio_unlock &bootloader,
//├─────────────┼─────────────┼─────────────┼─────────────┼─────────────┤ ├─────────────┼─────────────┼─────────────┼─────────────┼─────────────┤
    &sys_reset    XXX           XXX           XXX           XXX         ,   XXX           XXX           XXX           XXX           &sys_reset  ,
//╰─────────────┼─────────────┴─────────────┼─────────────┼─────────────┤ ├─────────────┼─────────────┼─────────────┴─────────────┴─────────────╯
                                              ___           ___         ,   ___           ___
//                                          ╰─────────────┴─────────────╯ ╰─────────────┴─────────────╯
)

#ifdef ENABLE_MOUSE_LAYER
#include <dt-bindings/zmk/pointing.h>

#define M_MOUSE_UP &mmv MOVE_UP
#define M_MOUSE_DOWN &mmv MOVE_DOWN
#define M_MOUSE_LEFT &mmv MOVE_LEFT
#define M_MOUSE_RIGHT &mmv MOVE_RIGHT

ZMK_BASE_LAYER(Mouse,
//╭─────────────┬─────────────┬─────────────┬─────────────┬─────────────╮ ╭─────────────┬─────────────┬─────────────┬─────────────┬─────────────╮
    XXX           &mkp MB4      XXX           &mkp MB5      XXX         ,   XXX           XXX           M_MOUSE_UP    XXX           XXX         ,
//├─────────────┼─────────────┼─────────────┼─────────────┼─────────────┤ ├─────────────┼─────────────┼─────────────┼─────────────┼─────────────┤
    &mo SCROLL    &mkp RCLK     &mkp MCLK     &mkp LCLK     XXX         ,   XXX           M_MOUSE_LEFT  M_MOUSE_DOWN  M_MOUSE_RIGHT XXX         ,
//├─────────────┼─────────────┼─────────────┼─────────────┼─────────────┤ ├─────────────┼─────────────┼─────────────┼─────────────┼─────────────┤
    XXX           XXX           XXX           XXX           XXX         ,   XXX           XXX           XXX           XXX           XXX         ,
//╰─────────────┼─────────────┴─────────────┼─────────────┼─────────────┤ ├─────────────┼─────────────┼─────────────┴─────────────┴─────────────╯
                                              ___           ___         ,   ___           ___
//                                          ╰─────────────┴─────────────╯ ╰─────────────┴─────────────╯
)

ZMK_BASE_LAYER(Scroll,
//╭─────────────┬─────────────┬─────────────┬─────────────┬─────────────╮ ╭─────────────┬─────────────┬─────────────┬─────────────┬─────────────╮
    ___           ___           ___           ___           ___         ,   ___           ___           ___           ___           ___         ,
//├─────────────┼─────────────┼─────────────┼─────────────┼─────────────┤ ├─────────────┼─────────────┼─────────────┼─────────────┼─────────────┤
    ___           ___           ___           ___           ___         ,   ___           ___           ___           ___           ___         ,
//├─────────────┼─────────────┼─────────────┼─────────────┼─────────────┤ ├─────────────┼─────────────┼─────────────┼─────────────┼─────────────┤
    ___           ___           ___           ___           ___         ,   ___           ___           ___           ___           ___         ,
//╰─────────────┼─────────────┴─────────────┼─────────────┼─────────────┤ ├─────────────┼─────────────┼─────────────┴─────────────┴─────────────╯
                                              ___           ___         ,   ___           ___
//                                          ╰─────────────┴─────────────╯ ╰─────────────┴─────────────╯
)
#endif
// }}};
