#include <behaviors/num_word.dtsi>
#include <behaviors/unicode.dtsi>

&sk { // Sticky Key
  release-after-ms = <900>;
  quick-release;
};

&lt { // Layer Tap
  flavor = "balanced";
  tapping-term-ms = <200>;
  quick-tap-ms = <QUICK_TAP_MS>;
};

&caps_word {
  /delete-property/ ignore-modifiers;
};

// Trigger tap-action on all interrupts.
#define MT_CORE \
  flavor = "tap-preferred"; \
  tapping-term-ms = <220>; \
  quick-tap-ms = <220>; \
  hold-trigger-key-positions = <0>;

&mt { 
  MT_CORE
};


// LGUI+Tab swapper, requires tri-state module.
ZMK_TRI_STATE(swapper, bindings = <&kt LGUI>, <&kp TAB>, <&kt LGUI>;
              ignored-key-positions = <LT2 RT2 RM1 RM2 RM3>;)

// Define mod-morph with a *single* mod trigger for less repetition.
#define SIMPLE_MORPH(NAME, MOD, BINDING1, BINDING2)                            \
  ZMK_MOD_MORPH(NAME, mods = <(MOD_L##MOD | MOD_R##MOD)>;                      \
                bindings = <BINDING1>, <BINDING2>;)

// Tap: comma | Shift + tap: semicolon | Ctrl + shift + tap: <.
SIMPLE_MORPH(comma_morph, SFT, &kp COMMA, &comma_inner_morph)
SIMPLE_MORPH(comma_inner_morph, CTL, &kp SEMICOLON, &kp LESS_THAN)

// Tap: dot | Shift + tap: colon | Ctrl + shift + tap: >.
SIMPLE_MORPH(dot_morph, SFT, &kp DOT, &dot_inner_morph)
SIMPLE_MORPH(dot_inner_morph, CTL, &kp COLON, &kp GREATER_THAN)

// Tap: qmark | Shift + tap: excl.
SIMPLE_MORPH(qexcl, SFT, &kp QMARK, &kp EXCL)

// Tap: space | Shift + tap: dot -> space -> sticky shift | Hold: layer.
ZMK_HOLD_TAP(lt_spc, bindings = <&mo>, <&spc_morph>; flavor = "balanced";
             tapping-term-ms = <200>; quick-tap-ms = <QUICK_TAP_MS>;)
SIMPLE_MORPH(spc_morph, SFT, &kp SPACE, &dot_spc)
ZMK_MACRO(dot_spc, bindings = <&kp DOT &kp SPACE &sk LSHIFT>; wait-ms = <0>;
          tap-ms = <5>;)

// Tap: bspc | Hold: shift
ZMK_HOLD_TAP(lt_shift, bindings = <&sk>, <&kp>; flavor = "balanced";
             tapping-term-ms = <200>; quick-tap-ms = <QUICK_TAP_MS>;)

// Tap: backspace | Lshift + tap: delete | Rshift + tap: shift-delete.
ZMK_MOD_MORPH(bs_del, bindings = <&kp BSPC>, <&kp DEL>;
              mods = <(MOD_LSFT|MOD_RSFT)>; keep-mods = <MOD_RSFT>;)

// Tap: Up | Ctrl + Up: Start of document (Ctrl+Home)
ZMK_MOD_MORPH(nav_up, bindings = <&kp UP>, <&kp LC(HOME)>; mods = <(MOD_LCTL)>;)

// Tap: Down | Ctrl + Down: End of document (Ctrl+End)
ZMK_MOD_MORPH(nav_down, bindings = <&kp DOWN>, <&kp LC(END)>; mods = <(MOD_LCTL)>;)

// Tap: Left | Ctrl + Left: Start of line (Home)
ZMK_MOD_MORPH(nav_left, bindings = <&kp LEFT>, <&kp HOME>; mods = <(MOD_LCTL)>;)

// Tap: Right | Ctrl + Right: End of line (End)
ZMK_MOD_MORPH(nav_right, bindings = <&kp RIGHT>, <&kp END>; mods = <(MOD_LCTL)>;)

// Tap: copy | long-tap: cut (single execution, no repeat).
ZMK_HOLD_TAP(mt_copy, bindings = <&mac_cut>, <&kp>; MT_CORE)

// Paste with initial delay before repeat
ZMK_HOLD_TAP(ht_delayed_paste,
  bindings = <&kp>, <&kp>;
  flavor = "hold-preferred";
  tapping-term-ms = <300>;  // delay before repeat starts (ms)
  quick-tap-ms = <0>;
  hold-trigger-key-positions = <0>;
)

ZMK_CONDITIONAL_LAYER(sys, SYM NUM, SYS)
ZMK_CONDITIONAL_LAYER(fn, SYM NAV, FN)
