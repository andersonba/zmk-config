#include <dt-bindings/zmk/behaviors.h>
#include <dt-bindings/zmk/keys.h>
#include <zmk-helpers/helper.h>
#include "../urchin_keylabels.h"

#define KEYS_L LT5 LT4 LT3 LT2 LT1 LT0     LM5 LM4 LM3 LM2 LM1 LM0     LB5 LB4 LB3 LB2 LB1 LB0
#define KEYS_R RT0 RT1 RT2 RT3 RT4 RT5     RM0 RM1 RM2 RM3 RM4 RM5     RB0 RB1 RB2 RB3 RB4 RB5
#define THUMBS TL1 TL0     TR0 TR1

#define MAKE_HRM(NAME, HOLD, TAP, TRIGGER_POS)                                 \
  ZMK_HOLD_TAP(NAME, bindings = <HOLD>, <TAP>; flavor = "balanced";            \
               tapping-term-ms = <280>; quick-tap-ms = <QUICK_TAP_MS>;         \
               require-prior-idle-ms = <150>; hold-trigger-on-release;         \
               hold-trigger-key-positions = <TRIGGER_POS>;)

MAKE_HRM(hml, &kp, &kp, KEYS_R THUMBS) // Left-hand HRMs.
MAKE_HRM(hmr, &kp, &kp, KEYS_L THUMBS) // Right-hand HRMs.

// Hack: Make HRM combos tap-only (cf, ZMK issue #544).
#define ZMK_COMBO_8(NAME, TAP, POS, LAYERS, COMBO_MS, IDLE_MS, HOLD, SIDE)     \
  MAKE_HRM(hm_combo_##NAME, &kp, TAP, SIDE THUMBS)                             \
  ZMK_COMBO_6(NAME, &hm_combo_##NAME HOLD 0, POS, LAYERS, COMBO_MS, IDLE_MS)


// Custom HRM: Mod: Shift | Tap: DOT | Shifted: Colon
ZMK_MOD_MORPH(ls_dot_colon,
    bindings = <&hml LSHFT PERIOD>, <&kp COLON>;
    mods = <(MOD_LSFT|MOD_RSFT)>;
)

// Custom HRM: Mod: GUI | Tap: QNS | Shifted: EXCL
ZMK_MOD_MORPH(lg_qns_excl,
    bindings = <&hml LGUI QMARK>, <&kp EXCL>;
    mods = <(MOD_LSFT|MOD_RSFT)>;
)
