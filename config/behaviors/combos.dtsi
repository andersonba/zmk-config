/*                                      
                 34 KEY MATRIX / LAYOUT MAPPING
  ╭─────────────────────────╮    ╭────────────────────────╮ 
  │  0   1   2   3   4   5  │    │ 6   7   8   9   10  11 │ 
  │ 12  13  14  15  16  17  │    │ 18  19  20  21  22  23 │ 
  │ 24  25  26  27  28  29  │    │ 30  31  32  33  34  35 │ 
  ╰──────────────╮  36  37  │    │ 38  39  ╭──────────────╯ 
                 ╰──────────╯    ╰─────────╯             

  ╭─────────────────────────╮    ╭─────────────────────────╮
  │ LT5 LT4 LT3 LT2 LT1 LT0 │    │ RT0 RT1 RT2 RT3 RT4 RT5 │
  │ LM5 LM4 LM3 LM2 LM1 LM0 │    │ RM0 RM1 RM2 RM3 RM4 RM5 │
  │ LB5 LB4 LB3 LB2 LB1 LB0 │    │ RB0 RB1 RB2 RB3 RB4 RB5 │
  ╰───────────────╮ TL1 TL0 │    │ TR0 TR1 ╭───────────────╯
                  ╰─────────╯    ╰─────────╯             
*/

#include "../urchin_keylabels.h"

#define COMBO_TERM_FAST 18
#define COMBO_TERM_SLOW 30

#define COMBO_IDLE_FAST 150
#define COMBO_IDLE_SLOW 50


/*  --------------  */
/*        Misc      */
/*  --------------  */

// Turn off the device

// Activate FUNC layer

// Screenshots


/*  --------------  */
/*     Left Hand    */
/*  --------------  */
// Tab 


/*  --------------  */
/*    Right Hand    */
/*  --------------  */

// Smart mouse

// Left Para (

// Right Para )

// Left Bracket [

// Right Bracket ]

// Backspace

// Enter
