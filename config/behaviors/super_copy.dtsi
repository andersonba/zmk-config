#include <dt-bindings/zmk/behaviors.h>
#include <dt-bindings/zmk/keys.h>
#include <zmk-helpers/helper.h>

// Tap: Copy | Double Tab: Paste | Ctrl: Cut | Alt: Mac Paste Cut file
ZMK_TAP_DANCE(copy_paste_cut, bindings = <&mt LG(X) LG(C)>, <&kp LG(V)>; 
              tapping-term-ms = <200>;)
ZMK_MOD_MORPH(copy_paste_cut_mv,
    bindings = <&copy_paste_cut>, <&kp LG(LA(V))>;
    mods = <(MOD_LCTL|MOD_RCTL)>;
)
