#define ENABLE_MOUSE_LAYER

#define _LH2_Base TD_MOUSE
#define _LH2_Alpha TD_MOUSE
#define _RH2_Num &kp RET

#define ZMK_BASE_LAYER(name, LT, RT, LM, RM, LB, RB, LH, RH) \
    ZMK_LAYER(name, \
                LT  RT             \
                LM  RM             \
                LB  RB             \
    _LH2(name)  LH  RH  _RH2(name) \
    )

#include <zmk-helpers/key-labels/36.h>
#include "base.dtsi"
