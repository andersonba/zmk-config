// Position-independent behaviors shared by base.dtsi and viginti.keymap.
// Include after the timings (QUICK_TAP_MS, TAPPING_TERM_MS, STICKY_RELEASE_MS);
// HRM instantiation stays per-board — key positions differ.

#include <dt-bindings/zmk/bt.h>
#include <behaviors/battery_percentage_printer.dtsi>

&sk { // Sticky Key
  release-after-ms = <STICKY_RELEASE_MS>;
  quick-release;
};

// Sticky layer (one-shot Num): quick-release frees the layer on the next key
// PRESS, so rolling "2a" types "2a", not "25".
&sl {
  release-after-ms = <STICKY_RELEASE_MS>;
  quick-release;
};

&soft_off {
  hold-time-ms = <2000>;
};

#define MAKE_HRM(NAME, HOLD, TAP, TRIGGER_POS, TAPPING_TERM, PRIOR_IDLE) \
  ZMK_HOLD_TAP(NAME, \
    bindings = <HOLD>, <TAP>; \
    flavor = "balanced"; \
    tapping-term-ms = <TAPPING_TERM>; \
    quick-tap-ms = <QUICK_TAP_MS>; \
    require-prior-idle-ms = <PRIOR_IDLE>; \
    hold-trigger-key-positions = <TRIGGER_POS>; \
    hold-trigger-on-release; \
  )

// BT profile keys: tap = select | hold = disconnect that profile (keeps the bond).
ZMK_MACRO_ONE_PARAM(bt_sel, bindings = <&macro_param_1to2>, <&bt BT_SEL MACRO_PLACEHOLDER>;)
ZMK_MACRO_ONE_PARAM(bt_disc, bindings = <&macro_param_1to2>, <&bt BT_DISC MACRO_PLACEHOLDER>;)
ZMK_HOLD_TAP(bt_prof, bindings = <&bt_disc>, <&bt_sel>;
  flavor = "tap-preferred";
  tapping-term-ms = <TAPPING_TERM_MS>;
)

// Clearing a bond is destructive: only fires on a long hold, tap does nothing.
// &bt takes two cells, so it rides a param-less macro to fit the hold-tap.
ZMK_MACRO(bt_clr_macro, bindings = <&bt BT_CLR>;)
ZMK_HOLD_TAP(bt_clr_hold, bindings = <&bt_clr_macro>, <&none>;
  flavor = "hold-preferred";
  tapping-term-ms = <500>;
)

// Smart num: hold = momentary Num | tap = one-shot Num (next key only).
// No lock on purpose: Num maps digits onto letter/space positions, so a
// num-word lock could never be ended by the next word.
ZMK_HOLD_TAP(smart_num, bindings = <&mo>, <&sl>;
  flavor = "hold-preferred";
  tapping-term-ms = <TAPPING_TERM_MS>;
  quick-tap-ms = <QUICK_TAP_MS>;
)
