// Tap: BINDING1 | shift + tap: BINDING2.
#define SIMPLE_MORPH(NAME, MOD, BINDING1, BINDING2)                            \
  ZMK_MOD_MORPH(NAME, mods = <(MOD_L##MOD | MOD_R##MOD)>;                      \
                bindings = <BINDING1>, <BINDING2>;)

// Dot + Space + Shift
ZMK_MACRO(dot_spc, bindings = <&kp DOT &kp SPACE &sk LSHIFT>; 
    wait-ms = <0>; tap-ms = <5>;)

// Mac
ZMK_MACRO(lock, bindings = <&kp LC(LG(Q))>;)
ZMK_MACRO(cut, bindings = <&kp LG(X)>;)

// Symbols: Both chars
ZMK_MACRO(both_par, bindings = <&kp LEFT_PARENTHESIS &kp RIGHT_PARENTHESIS &kp LEFT_ARROW>;)
ZMK_MACRO(both_brk, bindings = <&kp LEFT_BRACKET &kp RIGHT_BRACKET &kp LEFT_ARROW>;)
ZMK_MACRO(both_brc, bindings = <&kp LEFT_BRACE &kp RIGHT_BRACE &kp LEFT_ARROW>;)

// Tap: comma | shift + tap: semicolon
SIMPLE_MORPH(comma_semicolon, SFT, &kp COMMA, &kp SEMICOLON)

// Tap: dot | shift + tap: colon
SIMPLE_MORPH(dot_colon, SFT, &kp DOT, &kp COLON)

// Tap: qmark | shift + tap: excl.
SIMPLE_MORPH(qmark_excl, SFT, &kp QMARK, &kp EXCL)

// Tap: space | Shift + tap: dot -> space -> sticky shift.
SIMPLE_MORPH(spc_morph, SFT, &kp SPACE, &dot_spc)

&caps_word {
  /delete-property/ ignore-modifiers;
};

// magic shift {{{
ZMK_HOLD_TAP(magic_shift, bindings = <&kp>, <&magic_shift_tap>;
  flavor = "balanced"; tapping-term-ms = <200>;
  quick-tap-ms = <QUICK_TAP_MS>;)
ZMK_MOD_MORPH(magic_shift_tap, bindings = <&shift_repeat>, <&caps_word>;
  mods = <(MOD_LSFT)>;)
ZMK_ADAPTIVE_KEY(shift_repeat, bindings = <&sk LSHFT>;
  repeat {
    trigger-keys = <A B C D E F G H I J K L M N O P Q R S T U V W X Y Z>;
    bindings = <&key_repeat>;
    max-prior-idle-ms = <1200>;
    strict-modifiers;
  };)
// }}}