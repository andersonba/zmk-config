#define _LH2_Base &kp LGUI
#define _RH2_Base &kp RGUI
#define _LH2_Alpha &kp LGUI
#define _RH2_Alpha &kp RGUI
#define _RH2_Num &kp RET

#define ZMK_BASE_LAYER(name, LT, RT, LM, RM, LB, RB, LH, RH) \
    ZMK_LAYER(name, \
        &kp TAB    LT  RT  &kp BSPC  \
        &kp LCTRL  LM  RM  &kp RCTRL \
        &kp LSHFT  LB  RB  &kp ESC   \
       _LH2(name)  LH  RH  _RH2(name) \
    )

#include <zmk-helpers/key-labels/42.h>
#include "base.dtsi"